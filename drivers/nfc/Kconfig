## drivers/nfc/Kconfig
```kconfig
#
# Near Field Communication (NFC) devices
#

menuconfig NFC_DRIVERS
	bool "Near Field Communication (NFC) devices"
	default n
	help
	  You'll have to say Y if your computer contains an NFC device that
	  you want to use under Linux.

	  You can say N here if you don't have any Near Field Communication
	  devices connected to your computer.

if NFC_DRIVERS

source "drivers/nfc/pn7160/Kconfig"

endif
```
